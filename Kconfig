## Kconfig
```kconfig
# Sensor data simulator
#
# Copyright (c) 2019 Nordic Semiconductor
#
# SPDX-License-Identifier: LicenseRef-Nordic-5-Clause
#

menuconfig ADNS9800
	bool "ADNS9800 mouse optical sensor"
  select SPI
  depends on INPUT
  depends on DT_HAS_AVAGO_ADNS9800_ENABLED
	help
	  Enable ADNS9800 mouse optical sensor.

if ADNS9800

config INPUT_ADNS9800_INIT_PRIORITY
    int "ADNS9800 initialization priority"
    default INPUT_INIT_PRIORITY

config ADNS9800_SWAP_XY
  bool "Swap the X/Y axis of ADNS9800 sensor"

config ADNS9800_INVERT_X
  bool "Invert the X axis of ADNS9800 sensor"

config ADNS9800_INVERT_Y
  bool "Invert the Y axis of ADNS9800 sensor"

config ADNS9800_INIT_POWER_UP_EXTRA_DELAY_MS
  int "Extra power up init delay (ms)"
  default 0
  help
    Default minimum init power up delay is 10ms.
    Use this config to postpone init power up sequence if needs longer bootup time.

config ADNS9800_REPORT_INTERVAL_MIN
	int "ADNS9800's default minimum report rate"
	default 16
	help
	  Default minimum report interval in milliseconds.
		Slow down input reporting for hid queue over the air.
		Turn value down to 8ms to get sharp response if use with USB only.

config ADNS9800_RUN_DOWNSHIFT_TIME_MS
	int "ADNS9800's default RUN mode downshift time"
	default 50
	range 10 2550
	help
	  Default RUN mode downshift down time in milliseconds.
	  Time after which sensor goes from RUN to REST1 mode.

config ADNS9800_REST1_DOWNSHIFT_TIME_MS
	int "ADNS9800's default REST1 mode downshift time"
	default 5000
	range 320 81600
	help
	  Default REST1 mode downshift down time in milliseconds.
	  Time after which sensor goes from REST1 to REST2 mode.

config ADNS9800_REST2_DOWNSHIFT_TIME_MS
	int "ADNS9800's default REST2 mode downshift time"
	default 15000
	range 3200 816000
	help
	  Default REST2 mode downshift down time in milliseconds.
	  Time after which sensor goes from REST2 to REST3 mode.

config ADNS9800_REST1_RATE_MS
	int "ADNS9800's default REST1 rate"
	default 10
	help
	  Default REST1 mode sample rate in milliseconds.

config ADNS9800_REST2_RATE_MS
	int "ADNS9800's default REST2 rate"
	default 20
	help
	  Default REST2 mode sample rate in milliseconds.

config ADNS9800_REST3_RATE_MS
	int "ADNS9800's default REST3 rate"
	default 100
	help
	  Default REST3 mode sample rate in milliseconds.

module = ADNS9800
module-str = ADNS9800
source "${ZEPHYR_BASE}/subsys/logging/Kconfig.template.log_config"

endif #ADNS9800
```

## dts/bindings/avago,adns9800.yaml
```yaml
# Copyright (c) 2022 The ZMK Contributors
# SPDX-License-Identifier: MIT
description: |
  Sensor driver for the pixart ADNS9800 optical mouse sensor 

compatible: "avago,adns9800"

include: spi-device.yaml

properties:
  label:
    type: string
    required: false
    deprecated: true
  irq-gpios:
    type: phandle-array
    required: true
  evt-type:
    type: int
    required: true
  x-input-code:
    type: int
    required: true
  y-input-code:
    type: int
    required: true
```
